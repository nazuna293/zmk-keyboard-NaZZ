## boards/shields/NaZZ/Kconfig.defconfig
```kconfig
if SHIELD_NaZZ_L

config ZMK_KEYBOARD_NAME
    default "NaZZ"

config ZMK_USB
	  default y

config ZMK_BLE
    default y

config ZMK_SPLIT_ROLE_CENTRAL
    default y

endif

if SHIELD_NaZZ_L || SHIELD_NaZZ_R
config NFCT_PINS_AS_GPIOS
    default y

config ZMK_SPLIT
    default y

config ZMK_POINTING
    default y

config PAW3222
    default y

endif
```

## boards/shields/NaZZ/Kconfig.shield
```kconfig
config SHIELD_NaZZ_L
    def_bool $(shields_list_contains,NaZZ_L)

config SHIELD_NaZZ_R
    def_bool $(shields_list_contains,NaZZ_R)
```
