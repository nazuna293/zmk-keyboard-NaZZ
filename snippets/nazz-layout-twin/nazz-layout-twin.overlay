// 構成 twin（左右とも同じ snippet を指定する）

/ {
    chosen {
        zmk,physical-layout = &layout_twin;
    };
};

// 右手トラボを左手で受ける
&trackball_split {
    status = "okay";
};

&trackball_peripheral_listener {
    status = "okay";
};
